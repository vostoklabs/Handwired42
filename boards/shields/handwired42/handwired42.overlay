#include "handwired42.dtsi"

/*
 * Handwired 42 - 4 x 12 matrix on a nice!nano v2 (or nRF52840 SuperMini clone).
 *
 * Pins are given as raw nRF52840 GPIOs (&gpio0 = P0.xx, &gpio1 = P1.xx) so they
 * match the wiring list 1:1. Pro Micro names are in the comments.
 * Col 0 is the RIGHT-most column, Col 11 the LEFT-most (flipped in .dtsi).
 *
 * Diodes: col2row (columns are driven, rows are read), same as the Diplomat.
 * If NO keys register at all, the diodes are the other way round: change
 * diode-direction to "row2col" and move the GPIO_PULL_DOWN flags from the
 * rows onto the columns.
 */

/ {
    kscan0: kscan0 {
        compatible = "zmk,kscan-gpio-matrix";
        diode-direction = "col2row";
        wakeup-source;

        row-gpios
            = <&gpio0 29 (GPIO_ACTIVE_HIGH | GPIO_PULL_DOWN)>   // Row 0  P0.29  D20
            , <&gpio0  2 (GPIO_ACTIVE_HIGH | GPIO_PULL_DOWN)>   // Row 1  P0.02  D19
            , <&gpio1 15 (GPIO_ACTIVE_HIGH | GPIO_PULL_DOWN)>   // Row 2  P1.15  D18
            , <&gpio1 13 (GPIO_ACTIVE_HIGH | GPIO_PULL_DOWN)>   // Row 3  P1.13  D15
            ;

        col-gpios
            = <&gpio0 22 GPIO_ACTIVE_HIGH>   // Col 0   P0.22  D4
            , <&gpio0 24 GPIO_ACTIVE_HIGH>   // Col 1   P0.24  D5
            , <&gpio1  0 GPIO_ACTIVE_HIGH>   // Col 2   P1.00  D6
            , <&gpio0 11 GPIO_ACTIVE_HIGH>   // Col 3   P0.11  D7
            , <&gpio1  4 GPIO_ACTIVE_HIGH>   // Col 4   P1.04  D8
            , <&gpio1  6 GPIO_ACTIVE_HIGH>   // Col 5   P1.06  D9
            , <&gpio1  1 GPIO_ACTIVE_HIGH>   // Col 6   P1.01  (extra pad)
            , <&gpio1  2 GPIO_ACTIVE_HIGH>   // Col 7   P1.02  (extra pad)
            , <&gpio1  7 GPIO_ACTIVE_HIGH>   // Col 8   P1.07  (extra pad)
            , <&gpio0  9 GPIO_ACTIVE_HIGH>   // Col 9   P0.09  D10 (NFC pin)
            , <&gpio0 10 GPIO_ACTIVE_HIGH>   // Col 10  P0.10  D16 (NFC pin)
            , <&gpio0 20 GPIO_ACTIVE_HIGH>   // Col 11  P0.20  D3  (moved off P1.11 / D14)
            ;
    };
};

/*
 * P0.09 / P0.10 are the nRF52840 NFC antenna pins. Columns 9 and 10 use them,
 * so switch them to plain GPIOs (written once to UICR on first boot).
 */
&uicr {
    nfct-pins-as-gpios;
};

&physical_layout_handwired42 {
    kscan = <&kscan0>;
};
